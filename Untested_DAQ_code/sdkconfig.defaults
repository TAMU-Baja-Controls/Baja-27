## Working_Accelerated_DAQ/sdkconfig.defaults
```kconfig
CONFIG_BT_ENABLED=y
CONFIG_BT_BLE_ENABLED=y
CONFIG_BT_BLUEDROID_ENABLED=y
CONFIG_BT_CONTROLLER_ENABLED=y
CONFIG_FREERTOS_HZ=1000
CONFIG_ESP_COEX_SW_COEXIST_ENABLE=y
```
